## configs/sweet_defconfig
```kconfig
CONFIG_XNU_BUILD_ARCHIVES=y
CONFIG_XNU_NATIVE_UFS=y
CONFIG_XNU_NATIVE_RAM_BLOCK=y
CONFIG_XNU_NATIVE_MOBILE_DISPLAY=y
CONFIG_XNU_NATIVE_HID_INPUT=y
CONFIG_XNU_DT_PANIC_REGION=y
CONFIG_XNU_BOOT_PROGRESS=y
CONFIG_XNU_ARMVIRT_PLATFORM=n
```
